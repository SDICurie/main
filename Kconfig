## Kconfig
```kconfig
mainmenu "Curie BSP build configuration"

config PROJECT_PATH
	string
	option env="PROJECT_PATH"


menu "Project"

-source "$PROJECT_PATH/project.Kconfig"

endmenu

menu "Services"

source "framework/src/services/Kconfig"
-source "$PROJECT_PATH/services.Kconfig"

endmenu

menu "Packages"

config PKG_OUT
	string
	option env="PKG_OUT"

-source "packages/*/*/package.Kconfig"
-source "packages/*/*/*/package.Kconfig"
-source "$PKG_OUT/Kconfig"

endmenu

menu "Advanced Settings"

source "bsp/Kconfig"

source "framework/Kconfig"

endmenu

menu "Debug Settings"

config OS_UNIT_TESTS
	bool "OS Unit Tests"
	help
		Caution when selecting this option, as it will dramatically
		increase the output binary size.

config QUARK_DRIVER_TESTS
	bool "Quark driver tests"

config ARC_DRIVER_TESTS
	bool "Arc driver tests"

config ARC_OS_UNIT_TESTS
	bool "Arc OS unit tests"

config FACTORY_TESTS
	bool "Factory tests"

config GPIO_DRIVER_TESTS
	depends on GPIO
	depends on QUARK_DRIVER_TESTS || ARC_DRIVER_TESTS
	default y
	bool "GPIO driver tests"

endmenu

config INTERNAL_BSP_PATH
    string
    option env="INTERNAL_BSP_PATH"

-source "$INTERNAL_BSP_PATH/Kconfig"
```

## bsp/src/drivers/adc/Kconfig
```kconfig
config ADC
	bool

config SS_ADC
	bool "Sensor Subsystem ADC driver"
	depends on ARC
	select ADC
	select CLK_SYSTEM

config TCMD_ADC
       bool
       default y
       depends on SS_ADC
       depends on TCMD
```

## bsp/src/drivers/aio/Kconfig
```kconfig
config SOC_COMPARATOR
	bool "SOC Comparator driver"

config TCMD_COMPARATOR
	bool "Comparator Test Command"
	depends on TCMD
	depends on SOC_COMPARATOR

config MANAGED_COMPARATOR
	bool "Managed Comparator driver"
	depends on SOC_COMPARATOR

comment "The managed comparator requires the soc comparator driver"
	depends on !MANAGED_COMPARATOR
```

## bsp/src/drivers/charger/Kconfig
```kconfig
menu "Charger"

choice
	prompt "Charger"
	default BQ25101H
	depends on SERVICES_QUARK_SE_CHARGER
	help
	Pick the Charger driver according to your hardware/battery specification.

config BQ25101H
	bool "BQ25101H charger"
	depends on MANAGED_COMPARATOR
	help
	Enable internal Curie v2 charger driver.

config BQ25120
	bool "BQ25120 charger"
	select DRV_EOC_NOTIF_CAPA
	select DRV_FAULT_NOTIF_CAPA
	depends on INTEL_QRK_I2C
	depends on MANAGED_COMPARATOR
	help
	Enable BQ25120 charger driver.
endchoice

config DRV_EOC_NOTIF_CAPA
	bool "Driver end of charge notification capability"
	help
	Flag for charger driver capability

config DRV_FAULT_NOTIF_CAPA
	bool "Driver fault notification capability"
	help
	Flag for charger driver capability

endmenu
```

## bsp/src/drivers/display/Kconfig
```kconfig
config DISPLAY_HD44780
	bool "HD44780 display driver"
	depends on SOC_GPIO
	depends on SOC_GPIO_32

comment "HD44780 display driver requires SOC GPIO driver with GPIO 32 support"
	depends on !SOC_GPIO || !SOC_GPIO_32
```

## bsp/src/drivers/gpio/Kconfig
```kconfig
config GPIO
	bool

config SOC_GPIO
	bool "SOC GPIO Driver"
	select GPIO

if SOC_GPIO

menu "SOC GPIO active banks"

config SOC_GPIO_32
	bool "GPIO 32"

config SOC_GPIO_AON
	bool "GPIO AON"

endmenu

endif

config SS_GPIO
	bool "GPIO SS driver"
	select GPIO
```

## bsp/src/drivers/haptic/Kconfig
```kconfig
menu "Haptic"

config HAPTIC
	bool

config DRV2605
	bool "DRV2605 Haptic driver"
	depends on INTEL_QRK_I2C
	select HAPTIC

config DRV2605_TCMD
	bool "DRV2605 test commands"
	depends on DRV2605
	select HAPTIC

comment "DRV2605 Haptic driver requires the Intel I2C bus driver"
	depends on !INTEL_QRK_I2C

endmenu
```

## bsp/src/drivers/i2c/Kconfig
```kconfig
config I2C
	bool

config INTEL_QRK_I2C
	bool "Intel Quark I2C driver"
	select I2C
	select SBA
	select CLK_SYSTEM

config SS_I2C
	bool "SS I2C driver"
	select I2C
	select SBA
	select CLK_SYSTEM

config TCMD_I2C
	bool "I2C Test Commands"
	depends on I2C
	depends on TCMD
	select SBA
```

## bsp/src/drivers/ipc/Kconfig
```kconfig
config IPC_UART_NS16550
	bool "UART NS16550 IPC link driver"
	depends on UART_NS16550
	depends on SOC_GPIO && SOC_GPIO_32
	depends on OS_ZEPHYR

comment "The BLE core IPC link requires the UART driver and the SOC GPIO driver with GPIO 32 support"
	depends on !SOC_GPIO || !SOC_GPIO_32 || !UART_NS16550

config IPC_UART_BAUDRATE
	int "IPC UART Baudrate"
	default 115200
	depends on IPC_UART_NS16550 || BLE_CORE
```

## bsp/src/drivers/led/Kconfig
```kconfig
menu "LED"

config LED
	bool

config LED_MULTICOLOR
	bool

config SOC_LED
	bool "SOC Led driver"
	depends on INTEL_QRK_PWM
	select LED

comment "SOC Led driver requires the Intel PWM driver"
	depends on !INTEL_QRK_PWM

config LP5562_LED
	bool "LP5562 Led driver"
	depends on INTEL_QRK_I2C
	select LED
	select SBA
	select LED_MULTICOLOR

comment "LP5562 Led driver requires the Intel I2C bus driver"
	depends on !INTEL_QRK_I2C

config LP5562_LED_ENABLE
	bool
	depends on LP_5562_LED
	help
	This flag is set by boards that have the GPIO led enable wired

config LED_WAVE_SUPPORT
	bool "Led wave support"
	depends on LP5562_LED

choice
       depends on LP5562_LED
       prompt "LP5562 LED type"
       config LP_5562_LED_C113
       bool "C113"
       config LP_5562_LED_C115
       bool "C115"
       config LP_5562_LED_LX404
       bool "LX404"
       config LP_5562_LED_SMLP34
       bool "SMLP34"
endchoice

endmenu
```

## bsp/src/drivers/mtd/Kconfig
```kconfig
config SOC_FLASH
	bool "SOC Flash driver"

config SPI_FLASH
	bool

config SPI_FLASH_INTEL_QRK
	bool
	select SBA
	select SPI_FLASH

config SPI_FLASH_W25Q16DV
	bool "SPI NOR Flash Winbond W25Q16DV on Intel QRK"
	depends on INTEL_QRK_SPI
	select SPI_FLASH_INTEL_QRK

config SPI_FLASH_MX25
	bool
	select SPI_FLASH_INTEL_QRK
	help
	Macronix MX25xxxx nor flashes work pretty much in the same way,
	they can use the same commands set, you need to select just the
	different IDs and sizes.

config SPI_FLASH_MX25U12835F
	bool "SPI NOR Flash Macronix MX25U12835F on Intel QRK"
	depends on INTEL_QRK_SPI
	select SPI_FLASH_MX25

config SPI_FLASH_MX25R1635F
	bool "SPI NOR Flash Macronix MX25R1635F on Intel QRK"
	depends on INTEL_QRK_SPI
	select SPI_FLASH_MX25

config SPI_FLASH_MX25U1635E
	bool "SPI NOR Flash Macronix MX25U1635E on Intel QRK"
	depends on INTEL_QRK_SPI
	select SPI_FLASH_MX25

config SPI_FLASH_MX25R6435F
	bool "SPI NOR Flash Macronix MX25U6435F on Intel QRK"
	depends on INTEL_QRK_SPI
	select SPI_FLASH_MX25

comment "SPI Flash drivers require the Intel SPI bus driver"
	depends on !INTEL_QRK_SPI

config SOC_ROM
	bool "SOC Rom driver"
```

## bsp/src/drivers/nfc/Kconfig
```kconfig
config NFC_STN54
	bool "STN54 NFC chip on Intel QRK"
	depends on INTEL_QRK_I2C
	depends on SBA
	depends on I2C

config NFC_COMPARATOR_IRQ
	bool "Use comparator for IRQ_OUT interrupt"
	default y
	depends on NFC_STN54
	depends on SOC_COMPARATOR

menu "STN54 driver config"
	depends on NFC_STN54

	config STN54_I2C_ADDR
		hex "I2C address"
		default 0x08

	choice
		prompt "I2C bus"

	config NFC_STN54_ON_I2C0
		bool "I2C0"

	config NFC_STN54_ON_I2C1
		bool "I2C1"

	endchoice

	config STN54_RST_PIN
		int "Reset pin"
		default 15

	config STN54_IRQ_OUT_PIN
		int "IRQ_OUT pin"
		default 2

	config STN54_HAS_PWR_EN
		bool "STN54 has power enable pin"
		default n

	config STN54_PWR_EN_PIN
		int "Power enable pin"
		default 19
		depends on STN54_HAS_PWR_EN

	config STN54_HAS_BOOSTER
		bool "STN54E uses AS39230 RF booster chip"
		default n

	config STN54_BOOSTER_RST_PIN
		int "RF booster reset pin"
		default 18
		depends on STN54_HAS_BOOSTER

	config NFC_FW_MAJOR_VERSION
		hex "NFC firmware Major version"
		default 0x06

	config NFC_FW_MINOR_VERSION
		hex "NFC firmware Minor version"
		default 0x12

endmenu

config NFC_STN54_TCMD
	bool "STN54 NFC test commands"
	depends on NFC_STN54
```

## bsp/src/drivers/pm/Kconfig
```kconfig
config HAS_USB_PM
	bool

config USB_PM
	bool "USB cable detection driver"
	depends on HAS_USB_PM
	depends on SOC_COMPARATOR

comment "USB_PM requires the SOC_COMPARATOR driver to be selected"
	depends on !SOC_COMPARATOR

config BLE_CORE_SUSPEND_BLOCKER_PM
	bool "BLE Core suspend blocker driver"
	depends on HAS_BLE_CORE
	depends on SOC_GPIO_AON
```

## bsp/src/drivers/pwm/Kconfig
```kconfig
config INTEL_QRK_PWM
	bool "Intel Quark PWM driver"
	select CLK_SYSTEM

config TCMD_PWM
	bool "PWM test command"
	depends on INTEL_QRK_PWM
	help
	Enable or disable PWM test command
```

## bsp/src/drivers/rtc/Kconfig
```kconfig
config RTC
	bool

config INTEL_QRK_RTC
	bool "Intel Quark RTC driver"
	select RTC
	select CLK_SYSTEM

config INTEL_QRK_RTC_TCMD
	bool "Intel Quark RTC Test commands"
	depends on TCMD
	depends on INTEL_QRK_RTC

config INTEL_QRK_AON_PT
	bool "Intel Quark Always ON Periodic Timer (AONPT) driver"
```

## bsp/src/drivers/spi/Kconfig
```kconfig
config SPI
	bool

config INTEL_QRK_SPI
	bool "Intel Quark SPI driver"
	select SPI
	select SBA
	select CLK_SYSTEM

config SS_SPI
	bool "SS SPI driver"
	select SPI
	select SBA
	select CLK_SYSTEM

config TCMD_SPI
       bool
       default y
       depends on SBA
       depends on TCMD
       depends on SPI
```

## bsp/src/drivers/uart/Kconfig
```kconfig
config UART
	bool

config UART_NS16550
	bool "UART NS16550"
	select UART

config UART_PM_NS16550
	bool "Zephyr NS16550 driver power management wrapper"
	depends on UART_NS16550
	depends on OS_ZEPHYR
```

## bsp/src/drivers/usb/Kconfig
```kconfig
menu "USB"

config USB
	bool

config HAS_USB
	bool

config USB_SHARED_INTERFACE
	bool
	depends on QUARK_SE && HAS_USB

config USB_MSC_DEVICE_NAME
	string "USB MSC device name"
	default "CurieMSC"
	depends on USB_MSC

config USB_MSC_WRITE_PROTECTED
	bool "USB MSC Write Protected Mode"
	default y
	depends on USB_MSC

config USB_PRODUCT_ID
	hex "USB Product ID"
	default 0x0a9a
	depends on USB

config USB_VENDOR_ID
	hex "USB Vendor ID"
	default 0x8087
	depends on USB

choice
	prompt "USB Function driver"
	optional
	depends on HAS_USB

config USB_TEST_FUNCTION_DRIVER
	bool "Test"
	select USB

config USB_ACM
	bool "ACM"
	select USB
	select WORKQUEUE

config USB_MSC
	bool "MSC"
	select USB
	select WORKQUEUE

endchoice

config ACM_DUAL
	bool "Dual mode"
	depends on USB_ACM

endmenu
```

## bsp/src/drivers/wdt/Kconfig
```kconfig
config WDT
	bool

config INTEL_QRK_WDT
	bool "Intel Quark WDT driver"
	select WDT
	select CLK_SYSTEM
```

## bsp/src/infra/Kconfig
```kconfig
menu "Infra"

config IPC
	bool

config HAS_SHARED_MEM
	bool

menu "Port based communications"

config PORT_MULTI_CPU_SUPPORT
	bool "Support communications between multiple CPUs"
	default y
	select IPC
	help
	Allow messages to be exchanged between cores.

config PORT_IS_MASTER
	bool "Act as the master for port communications"

endmenu

menu "Panic handling"

config PANIC_ON_BUS_ERROR
	bool "Panic on bus error"
	help
	Panic when a bus error is catched on the bus

config PANIC_DUMP_ON_REBOOT
	bool "Panic dump copy to NVM after reboot"
	depends on BLE_CORE
	help
	Copy panic dump from RAM to NVM just after master core reset

config DEBUG_PANIC_TCMD
	bool "Debug panic Test commands"
	depends on TCMD

endmenu

menu "Logging"

config LOG_MULTI_CPU_SUPPORT
	bool "Multi-CPU log support"
	default y
	select IPC
	help
	When this option is active, logs will be routed using IPC from slaves CPUs
	to a single master CPU.

choice
	prompt "Master/Slave"
	depends on LOG_MULTI_CPU_SUPPORT
	default LOG_SLAVE if QUARK_SE_BLE_CORE

config LOG_MASTER
	bool "Master"
	help
	Master receives log messages from all slaves CPUs.

config LOG_SLAVE
	bool "Slave"
	help
	Slave send log messages to master.

endchoice

choice
	prompt "Message logging implementation"
	default LOG_LOCAL if QUARK_SE_BLE_CORE

config LOG_PRINTK
	bool "Simple printk log implementation"
	depends on LOG_MASTER || !LOG_MULTI_CPU_SUPPORT
	help
	A simple log implementation using an externally provided printk function.

config LOG_PRINTF
	bool "Simple printf log implementation"
	depends on LOG_MASTER || !LOG_MULTI_CPU_SUPPORT
	help
	A simple log implementation using an externally provided printf function.

config LOG_CBUFFER
	bool "Circular Buffer Log implementation"
	help
	A log implementation using a circular log buffer and a dedicated
	low-priority log task doing the actual flush.

config LOG_LOCAL
	bool "Local implementation of message logging"
	help
	The project implements its own message logging function.

endchoice

config LOG_EXTRA_TCMD
       bool "Extra log Test commands"
       depends on TCMD

config LOG_CBUFFER_SIZE
	int "Circular Log Buffer Size (bytes)"
	default 1024
	depends on LOG_CBUFFER
	help
	The size of the Circular Log Buffer (in bytes)

endmenu

config PROPERTIES_STORAGE
	bool "Properties Storage"
	help
	A generic key/value storage

config FACTORY_DATA
	bool "Add support for factory data read"

config FACTORY_DATA_WRITE
	bool "Add support for factory data insertion"
	depends on SOC_ROM

config VERSION
	bool "Binary version header"
	default y

config LOG_BACKEND_USB
	bool "Log over USB"
	depends on USB_ACM
	help
	When enabled logging can be over USB.

config CONSOLE_MANAGER
	bool "Console Manager"
	help
	Manage multiple consoles for test commands and logging.

config CONSOLE_BACKEND_USB_ACM
	bool "USB ACM Console Backend"
	depends on LOG_BACKEND_USB
	depends on CONSOLE_MANAGER
	default y
	help
	Enables USB ACM console backend for test commands and logging.

config CONSOLE_BACKEND_UART
	bool "UART Console Backend"
	depends on CONSOLE_MANAGER
	default y
	help
	Enables UART console backend for test commands and logging

config CONSOLE_BACKEND_FLASH
	bool "SPI NOR FLASH Console Backend"
	depends on QUARK_SE_QUARK_LOG_BACKEND_FLASH
	depends on CONSOLE_MANAGER
	default n
	help
	Enables SPI flash console backend for logging

config CONSOLE_BACKEND_USB_ACM_LOG_ACTIVATED
	bool "Logging on USB ACM console activated by default"
	depends on CONSOLE_BACKEND_USB_ACM
	default n
	help
	Activates Logging onto USB ACM console by default

config CONSOLE_BACKEND_UART_LOG_ACTIVATED
	bool "Logging on UART console activated by default"
	depends on CONSOLE_BACKEND_UART
	default y
	help
	Activates Logging onto UART console by default

config CONSOLE_BACKEND_FLASH_LOG_ACTIVATED
	bool "Logging to SPI FLASH activated by default"
	depends on CONSOLE_BACKEND_FLASH
	default y
	help
	Activates Logging to SPI Flash by default

config SYSTEM_EVENTS
	bool "System events support"
	depends on SPI_FLASH
	select CSTORAGE_FLASH_SPI
	help
	System events are events generated by the system on important events.

comment "System events require a SPI Flash driver"
	depends on !SPI_FLASH

config SYSTEM_EVENTS_TCMD
	bool "System events debug test command"
	depends on SYSTEM_EVENTS
	default n
	help
	Test command that allows dumping system events.

source "bsp/src/infra/tcmd/Kconfig"

endmenu
```

## bsp/src/machine/Kconfig
```kconfig
# The order of the definitions in this file is important, as it conditions
# how values can be overridden:
#
# Board > SoC
#

# Board features
config BOARD_PATH
	string
	option env="BOARD_PATH"

-source "$BOARD_PATH/Kconfig"

# SoC features
config SOC_PATH
	string
	option env="SOC_PATH"

-source "$SOC_PATH/Kconfig"

# Architecture
config ARCH
	string
	option env="ARCH"

config HAS_FLOAT
	bool

config HAS_ARC
	bool

config HAS_QUARK
	bool

config HAS_BLE_CORE
	bool

choice
	prompt "Core"
	depends on HAS_ARC || HAS_QUARK || HAS_BLE_CORE

config ARC
	bool "ARC"
	depends on HAS_ARC

config QUARK
	bool "Quark"
	depends on HAS_QUARK

config BLE_CORE
	bool "BLE Core"
	depends on HAS_BLE_CORE

endchoice

config BLE_LPM
	bool "BLE Low Power Mode"
	depends on BLE_CORE

config CORE_NAME
	string
	default "arc" if ARC
	default "quark" if QUARK
	default "ble_core" if BLE_CORE

config RECOVERY_BOOT_TARGET
	bool
	help
		Mode to fallback when the main application mode is considered not
		functional anymore.
		It should be implemented by the board/application.

comment "Define a proper Board Configuration to enable the Core menu"
	depends on !HAS_ARC && !HAS_QUARK && !HAS_BLE_CORE
```
