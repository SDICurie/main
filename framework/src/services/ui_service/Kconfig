## framework/src/services/ui_service/Kconfig
```kconfig
menu "User Interface"

config UI_SERVICE_IMPL
	bool "UI service implementation"
	depends on HAPTIC || LED || BUTTON
	select CFW

comment "The UI service requires at least a Led, Haptic or Button driver"
	depends on !HAPTIC && !LED && !BUTTON

config UI_SERVICE_IMPL_BUTTON
	bool "Button support"
	default y
	depends on BUTTON
	depends on UI_SERVICE_IMPL

config UI_SERVICE_IMPL_LED
	bool "LED support"
	default y
	depends on LED
	depends on UI_SERVICE_IMPL

config UI_SERVICE_IMPL_HAPTIC
	bool "Haptic support"
	default y
	depends on HAPTIC
	depends on UI_SERVICE_IMPL

comment "Select a driver to add Haptic support"
	depends on !HAPTIC

config TCMD_UI_SVC
	bool "UI Service Test Command"
	depends on TCMD
	depends on UI_SERVICE_IMPL

config UI_SERVICE
	bool "UI service interface"
	select CFW

source "framework/src/lib/button/Kconfig"
source "framework/src/lib/led/Kconfig"

endmenu
```

## projects/curie_ble/arc/defconfig
```kconfig
CONFIG_AUTO_SERVICE_INIT=y
CONFIG_BMI160_SPI=y
CONFIG_BMI160=y
CONFIG_CFW_PROXY=y
CONFIG_CFW_QUARK_SE_HELPERS=y
CONFIG_LOG_SLAVE=y
CONFIG_MEM_POOL_DEF_PATH="$(PROJECT_PATH)/arc"
CONFIG_OS_ZEPHYR=y
CONFIG_SERVICES_SENSOR_IMPL=y
CONFIG_SERVICES_SENSOR=y
CONFIG_SOC_GPIO_AON=y
CONFIG_SOC_GPIO=y
CONFIG_SS_I2C=y
CONFIG_SS_SPI=y
CONFIG_TCMD_SLAVE=y
CONFIG_TCMD=y
CONFIG_ZEPHYR_BOARD="arduino_101_sss"
```

## projects/curie_ble/quark/defconfig
```kconfig
CONFIG_AUTO_SERVICE_INIT=y
CONFIG_BLE_APP=y
# CONFIG_BLE_HRS_LIB is not set
# CONFIG_BLE_LNS_LIB is not set
CONFIG_CFW_QUARK_SE_HELPERS=y
CONFIG_CONSOLE_MANAGER=y
CONFIG_DEBUG_PANIC_TCMD=y
CONFIG_FACTORY_DATA_WRITE=y
CONFIG_FACTORY_DATA=y
CONFIG_INTEL_QRK_AON_PT=y
CONFIG_INTEL_QRK_RTC=y
CONFIG_INTEL_QRK_SPI=y
CONFIG_INTEL_QRK_WDT=y
CONFIG_IPC_UART_NS16550=y
CONFIG_LOG_CBUFFER_SIZE=2048
CONFIG_LOG_CBUFFER=y
CONFIG_MEM_POOL_DEF_PATH="$(PROJECT_PATH)/quark"
CONFIG_OS_ZEPHYR=y
CONFIG_PANIC_ON_BUS_ERROR=y
CONFIG_QUARK_SE_PROPERTIES_STORAGE=y
CONFIG_QUARK=y
CONFIG_SERVICES_BLE_IMPL=y
CONFIG_SERVICES_BLE=y
CONFIG_SERVICES_QUARK_SE_PROPERTIES_IMPL=y
CONFIG_SERVICES_QUARK_SE_PROPERTIES=y
CONFIG_SERVICES_SENSOR=y
CONFIG_SOC_FLASH=y
CONFIG_SOC_GPIO_32=y
CONFIG_SOC_GPIO=y
CONFIG_SOC_ROM=y
CONFIG_SPI_FLASH_W25Q16DV=y
CONFIG_STORAGE_TASK=y
CONFIG_TCMD_CONSOLE=y
CONFIG_TCMD_MASTER=y
CONFIG_TCMD=y
CONFIG_UART_NS16550=y
CONFIG_UART_PM_NS16550=y
CONFIG_ZEPHYR_BOARD="arduino_101"
```
