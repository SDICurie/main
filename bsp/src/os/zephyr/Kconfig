## bsp/src/os/zephyr/Kconfig
```kconfig
if OS_ZEPHYR

menu "Zephyr OS"

config OS_ZEPHYR_MDEF
	string "Main application configuration file"
	default "main.mdef"

config ZEPHYR_CONF_FILE
        string "Zephyr configuration file path"
        default "prj-Intel.conf"

config ZEPHYR_BOARD
	string "Name of the zephyr BOARD"
	default "?"

endmenu

config QUEUE_ELEMENT_POOL_SIZE
	int "Max queue elements for queues"
	default 100

config TIMER_POOL_SIZE
	int "Max usable timers"
	default 20

endif
```

## bsp/src/util/Kconfig
```kconfig
menu "Utility libraries"

config WORKQUEUE
	bool "An OS agnostic workqueue implementation"

config ZEPHYR_WORKQUEUE_TASK_STACKSIZE
	int "Stacksize of the workqueue task"
	default 1024
	depends on WORKQUEUE

config CUNIT_TESTS
	bool "Unit Tests Utils"

menu "Flash circular storage"
	depends on SPI_FLASH

config CSTORAGE_FLASH_SPI
	bool "SPI Flash circular storage"
	depends on SPI_FLASH
	select PACKAGE_CIR_STORAGE

config PROFILING
	bool "add -finstrument-functions"

endmenu

comment "The FLASH circular storage requires a SPI Flash driver"
	depends on !SPI_FLASH

config MEMORY_POOLS_BALLOC
	bool "Use memory pool-based balloc implementation"

config MEMORY_POOLS_BALLOC_STATISTICS
	bool "Collect balloc usage statistics"
	help
	Collect balloc usage statistics and add a test command to display them

config MEMORY_POOLS_BALLOC_TRACK_OWNER
	bool "Tracks memory block owners"
	depends on MEMORY_POOLS_BALLOC_STATISTICS

config DBG_POOL_TCMD
       bool "Dbg pool Test commands"
       depends on TCMD

endmenu
```

## framework/Kconfig
```kconfig
menuconfig CFW
	bool "Component Framework for services"
	select IPC
	select CFW_CLIENT
	select CFW_SERVICE

if CFW

source "framework/src/cfw/Kconfig"
source "framework/src/tcmd/Kconfig"
source "framework/src/lib/Kconfig"

endif
```

## framework/src/cfw/Kconfig
```kconfig
choice
	prompt "Master/Proxy"
	depends on CFW

config CFW_MASTER
	bool "Master"
	select PORT_IS_MASTER
	help
	The Master Framework node is in charge of dispatching service requests and
	responses.

config CFW_PROXY
	bool "Proxy"
	help
	A Proxy node registers its services to the Master node and honours requests
	received from the Master.

endchoice

config CFW_QUARK_SE_HELPERS
	bool "Provides the cfw_init() function on Quark SE"
	depends on QUARK_SE

config CFW_CLIENT
	bool "Client api"
	help
	Component framework client interface. This allows to create component
	framework clients.

config CFW_SERVICE
	bool "Service api"
	help
	Component framework service interface. This allows to create component
	framework services.
```

## framework/src/lib/ble/dis/Kconfig
```kconfig
config BLE_DIS_LIB
	bool "BLE Device Info Service library"
	default y if BLE_APP

config BLE_DIS_SYSTEM_ID
	bool "Include DIS system ID characteristic"
	depends on BLE_DIS_LIB
	default n
```

## framework/src/lib/ble/lns/Kconfig
```kconfig
config BLE_LNS_LIB
	bool "BLE Location and Navigation service library"
	default y if BLE_APP
```

## framework/src/lib/ble/rscs/Kconfig
```kconfig
config BLE_RSCS_LIB
	bool "BLE Running Speed and Cadence service library"
	default y if BLE_APP

config BLE_RSCS_SENSOR_LOCATION_SUPPORT
	bool "BLE Running Speed and Cadence Sensor Location Support"
	depends on BLE_RSCS_LIB
	default y if BLE_RSCS_LIB

config BLE_RSCS_MULTIPLE_SENSOR_LOCATION_SUPPORT
	bool "BLE Running Speed and Cadence Multiple Sensor Location Support"
	depends on BLE_RSCS_SENSOR_LOCATION_SUPPORT
	default y if BLE_RSCS_SENSOR_LOCATION_SUPPORT
```

## framework/src/lib/ble/tcmd/Kconfig
```kconfig
config TCMD_BLE
	bool "BLE test commands"
	depends on TCMD
	depends on SERVICES_BLE
	default y if SERVICES_BLE

config TCMD_BLE_DTM
	bool "BLE DTM test commands"
	depends on TCMD_BLE
	default y if TCMD_BLE

config TCMD_BLE_DEBUG
	bool "BLE debug test commands"
	depends on TCMD_BLE
```

## framework/src/lib/button/Kconfig
```kconfig
menu "Buttons"

config BUTTON
	bool

config BUTTON_LIB
	bool
	help
	This flag is used to compile the button generic lib

config BUTTON_GPIO_SVC
	bool "Button wrapper based on gpio service"
	select SERVICES_QUARK_SE_GPIO
	select BUTTON
	select BUTTON_LIB
	help
	Button wrapper based on gpio service

config BUTTON_MULTIPLE_PRESS
	bool "Notify when several buttons are pressed in the same time"
	depends on BUTTON_LIB
	help
	Send a MULTIPLE_PRESS notification if several buttons are pressed
	in the same time

config BUTTON_FEEDBACK
	bool "Feedback between button actions"
	depends on BUTTON_LIB
	help
	Send a feedback notification between button timing based actions
endmenu
```

## framework/src/lib/led/Kconfig
```kconfig
menu "LED"

config GPIO_LED
    bool "Simple LED based on gpio service"
    select LED
    select SERVICES_QUARK_SE_GPIO

endmenu
```

## framework/src/services/Kconfig
```kconfig
source "framework/src/services/ble_service/Kconfig"
source "framework/src/services/circular_storage_service/Kconfig"
source "framework/src/services/ui_service/Kconfig"
source "framework/src/services/nfc_service/Kconfig"
source "framework/src/services/test_service/Kconfig"
source "framework/src/services/battery_service/Kconfig"
source "framework/src/services/gpio_service/Kconfig"
source "framework/src/services/adc_service/Kconfig"
source "framework/src/services/ll_storage_service/Kconfig"
source "framework/src/services/properties_service/Kconfig"
source "framework/src/services/sensor_service/Kconfig"

comment "*"

menu Extras

config STORAGE_TASK
	bool "Storage Task"
	help
	The storage task is a low priority task dedicated to the asynchronous
	handling of blocking flash operations.

if STORAGE_TASK

config  STORAGE_TASK_STACK_SIZE
    int "Stack size of storage task"
    default 2048

config STORAGE_TASK_QUEUE_SIZE
    int "Storage task queue size"
    default 10

endif

config AUTO_SERVICE_INIT
	bool "Activate the auto initialization of enabled services"

endmenu
```

## framework/src/services/adc_service/Kconfig
```kconfig
menu "Analog Digital Converter"

config SERVICES_QUARK_SE_ADC
	bool "Client"
	select CFW

config SERVICES_QUARK_SE_ADC_IMPL
	bool "Server"
	depends on ADC
	select CFW

comment "The ADC server requires an ADC driver"
	depends on !ADC

endmenu
```

## framework/src/services/battery_service/Kconfig
```kconfig
menu "Battery"

config SERVICES_QUARK_SE_BATTERY
	bool "Client"
	select CFW
	select SERVICES_QUARK_SE_PROPERTIES

config SERVICES_QUARK_SE_BATTERY_IMPL
	bool "Server"
	select CFW
	depends on USB_PM
	depends on HAS_BATTERY
	depends on CHARGER
	select BATTERY
	select SERVICES_QUARK_SE_POWER_SUPPLY
	select SERVICES_QUARK_SE_CHARGER
	select SERVICES_QUARK_SE_FUELGAUGE

comment "SERVICES_QUARK_SE_BATTERY_IMPL requires the USB cable detection driver"
	depends on !USB_PM

source "framework/src/services/battery_service/battery_LUT/Kconfig"

menu "Software drivers"

config SERVICES_QUARK_SE_CHARGER
	bool "Charging Service"
	select SERVICES_QUARK_SE_GPIO
	depends on WORKQUEUE

config CHARGER
	bool "Charger feature"
	help
	Enable the Charger

config QI_BQ51003
	bool "QI charging driver for BQ51003"
	depends on SERVICES_QUARK_SE_CHARGER
	help
	Enable the wireless charging feature for QI standard.

config USB_POWER_SUPPLY
	bool "USB charging driver"
	depends on SERVICES_QUARK_SE_CHARGER
	depends on USB_PM
	depends on WORKQUEUE

config SERVICES_QUARK_SE_FUELGAUGE
	bool "Fuel gauge"
	select SERVICES_QUARK_SE_ADC
	select SERVICES_QUARK_SE_GPIO
	select SERVICES_QUARK_SE_CHARGER

config CH_SW_EOC
	int "Software end of charge detection(minute)"
	default 0
	help
	Manage end of charge detection by software / Put 0 to disable

config SW_TEMP_MNG
	bool "Software Temperature Management"
	default n
	help
	Manage charger by system temperature

config BATT_ADC_FACTOR
	int "Battery ADC factor"
	default 1
	depends on SERVICES_QUARK_SE_FUELGAUGE

config A_TEMP_ADC_FACTOR
	int "Temperature ADC factor slope factor"
	default 1
	depends on SERVICES_QUARK_SE_FUELGAUGE

config B_TEMP_ADC_FACTOR
	int "Temperature ADC factor Y intercept factor"
	default 1
	depends on SERVICES_QUARK_SE_FUELGAUGE

config FG_USE_SS_GPIO
	bool "Fuel gauge SS gpio usage"
	default y
	depends on SERVICES_QUARK_SE_FUELGAUGE

config FG_VOLT_LS_GPIO
	int "GPIO number for FG voltage load switch pin"
	default 14
	depends on SERVICES_QUARK_SE_FUELGAUGE

config FG_TEMP_LS_GPIO
	int "GPIO number for FG temperature load switch pin"
	default 14
	depends on SERVICES_QUARK_SE_FUELGAUGE

config FG_DFLT_VOLTAGE_PERIOD_MEASURE
	int "(ms) Period to realize voltage measure / 1000min / 65000max"
	default 30000
	depends on SERVICES_QUARK_SE_FUELGAUGE

config FG_DFLT_TEMPERATURE_PERIOD_MEASURE
	int "(ms) Period to realize voltage measure / 1000min / 65000max / 0 disable measure"
	default 60000
	depends on SERVICES_QUARK_SE_FUELGAUGE

config CH_SW_EOC
	int "(min) Time before sending the EOC from SOC=100% / 0 disable this feature"
	default 0

config FG_HYST_TEMP_THRESHOLD
	int "(degree) Hysteresis temperature threshold"
	default 5
	depends on SERVICES_QUARK_SE_FUELGAUGE

config FG_HIGH_CHARGER_TEMP_THRESHOLD
	int "(degree) High charger temperature threshold"
	default 45
	depends on SERVICES_QUARK_SE_FUELGAUGE
	help
	Shutdown charger for this threshold value

config FG_LOW_CHARGER_TEMP_THRESHOLD
	int "(degree) Low charger temperature threshold"
	default 0
	depends on SERVICES_QUARK_SE_FUELGAUGE
	help
	Shutdown charger for this threshold value

config FG_DFLT_CRITICAL_ALARM_HIGH_TEMP
	int "(degree) high temperature to send alarm"
	default 55
	depends on SERVICES_QUARK_SE_FUELGAUGE

config FG_DFLT_SHUTDOWN_ALARM_HIGH_TEMP
	int "(degree) high temperature to initiate shutdown"
	default 60
	depends on SERVICES_QUARK_SE_FUELGAUGE

config FG_DFLT_CRITICAL_ALARM_LOW_TEMP
	int "(degree) low temperature to send alarm"
	default 0
	depends on SERVICES_QUARK_SE_FUELGAUGE

config FG_DFLT_SHUTDOWN_ALARM_LOW_TEMP
	int "(degree) low temperature to initiate shutdown"
	default -5
	depends on SERVICES_QUARK_SE_FUELGAUGE

endmenu

endmenu
```

## framework/src/services/battery_service/battery_LUT/Kconfig
```kconfig
menu "LUT"

choice
	prompt "Battery LUT"
	default CUSTOM_LUT
	depends on SERVICES_QUARK_SE_BATTERY_IMPL
	help
	Pick the LUT according to your hardware/battery specification.

config CUSTOM_LUT
	bool "LUT for Custom battery "

config FG_LUT_P0469
	bool "LUT for P0469LF battery "

config FG_LUT_FC_SYNERGY2
	bool "LUT for FCSYNERGY2 battery"

config FG_LUT_B45MAH
	bool "LUT for 45mAh Li-Lon battery"

endchoice

config VOLT_SHUTDOWN_THRESHOLD
	int "Battery Volt shuthdown threshold"
	default 3200

endmenu
```

## framework/src/services/ble_service/Kconfig
```kconfig
menu "BLE Service"

config SERVICES_BLE
	bool "BLE CFW based service APIs"
	select CFW
	select BLUETOOTH_PERIPHERAL

config SERVICES_BLE_IMPL
	bool "BLE CFW base service implementation"
	select CFW
	select BLUETOOTH_PERIPHERAL
	select BLUETOOTH_SMP

config SERVICES_BLE_GATTC
	bool "BLE GATT Client APIs"
	select BLUETOOTH_GATT_CLIENT

config SERVICES_BLE_STORAGE
	bool "Use properties storage to store ble nv data"
	depends on SERVICES_BLE_IMPL
	depends on SERVICES_QUARK_SE_PROPERTIES
	default y if SERVICES_QUARK_SE_PROPERTIES

config SERVICES_BLE_CENTRAL
	bool "BLE CFW based central role APIs"
	depends on SERVICES_BLE

menuconfig RPC
	bool "RPC support"
	default y
	depends on IPC_UART_NS16550 || BLE_CORE

comment "The BLE core RPC mechanism on the quark requires the UART NS16550 driver"
	depends on !IPC_UART_NS16550

config RPC_OUT
	bool "Issues RPC requests"
	default y
	depends on RPC

config RPC_IN
	bool "Implements RPC requests"
	default y
	depends on RPC

endmenu
```

## framework/src/services/circular_storage_service/Kconfig
```kconfig
menu "Circular storage"

config SERVICES_QUARK_SE_CIRCULAR_STORAGE
	bool "Client"
	select CFW

config SERVICES_QUARK_SE_CIRCULAR_STORAGE_IMPL
	bool "Server"
	select CFW
	depends on CSTORAGE_FLASH_SPI
	depends on STORAGE_TASK

comment "The Circular Storage service requires the Flash SPI circular storage library and the storage task"
	depends on !CSTORAGE_FLASH_SPI || !STORAGE_TASK

endmenu
```

## framework/src/services/gpio_service/Kconfig
```kconfig
menu "GPIO"

config SERVICES_QUARK_SE_GPIO
	bool "Quark SE GPIO service client"
	select CFW

config SERVICES_QUARK_SE_GPIO_IMPL
	bool "Quark SE GPIO service server"
	depends on GPIO
	select CFW

comment "GPIO server requires a GPIO driver to be selected"
	depends on !GPIO

endmenu
```

## framework/src/services/ll_storage_service/Kconfig
```kconfig
menu "Low level storage"

config SERVICES_QUARK_SE_LL_STORAGE
	bool "Client"
	select CFW

config SERVICES_QUARK_SE_LL_STORAGE_IMPL
	bool "Server"
	depends on SOC_FLASH || SPI_FLASH
	select CFW
	depends on STORAGE_TASK

comment "The LL storage service requires a SOC or SPI Flash driver and the storage task"
	depends on (!SOC_FLASH && !SPI_FLASH) || !STORAGE_TASK

endmenu
```

## framework/src/services/nfc_service/Kconfig
```kconfig
menu "NFC Service"

config NFC_SERVICE
	bool "NFC service interface"
	depends on CFW

config NFC_SERVICE_IMPL
	bool "NFC service implementation"
	depends on CFW

config NFC_STN54_SUPPORT
	bool "STN54x NFC chip support"
	depends on NFC_STN54

config NFC_STN54_FW_UPDATE
	bool "Enable FW update"
	depends on HAS_SPI_FLASH
	depends on NFC_STN54_SUPPORT

config NFC_STN54_HIBERNATE
	bool "Enable hibernate support"
	depends on NFC_STN54_SUPPORT

config NFC_STN54_DEBUG_RX_MESSAGE
	bool "Print RX message information"
	depends on NFC_STN54_SUPPORT

config NFC_STN54_AMS_DEBUG_TCMD
	bool "Enable booster/antenna tunning test commands"
	depends on NFC_STN54_SUPPORT
	depends on NFC_STN54_TCMD
	depends on NFC_STN54_DEBUG_RX_MESSAGE

config NFC_STN54_FSM_TCMD
	bool "Enable FSM test commands"
	depends on NFC_STN54_SUPPORT

endmenu
```

## framework/src/services/properties_service/Kconfig
```kconfig
menu "Properties"

config SERVICES_QUARK_SE_PROPERTIES
	bool "Client"
	select CFW

config SERVICES_QUARK_SE_PROPERTIES_IMPL
	bool "Server"
	select CFW
	depends on STORAGE_TASK
	depends on QUARK_SE_PROPERTIES_STORAGE

comment "The Properties service requires the property storage library and the storage task"
	depends on !QUARK_SE_PROPERTIES_STORAGE || !STORAGE_TASK

config TCMD_SERVICES_QUARK_SE_PROPERTIES
	bool "Test command"
	depends on TCMD
	depends on SERVICES_QUARK_SE_PROPERTIES_IMPL

endmenu
```

## framework/src/services/sensor_service/Kconfig
```kconfig
menu "Sensors"

config SERVICES_SENSOR
	bool "Client"
	select CFW

config SERVICES_SENSOR_IMPL
	bool "Server"
	depends on BMI160
	select CFW
	select SERVICES_QUARK_SE_PROPERTIES
	select SENSOR_CORE

comment "The sensor server requires the BMI160 driver"
	depends on !BMI160

config SENSOR_CORE
	bool

config SERVICES_SENSOR_TCMD
	bool "Sensor service Test Commands"
	depends on SERVICES_SENSOR
	depends on TCMD

if SENSOR_CORE

menu "Sensor Core Algorithms"

config SENSOR_CORE_ALGO_UDG
	bool "User Defined Gesture"
	depends on PATTERN_MATCHING_DRV
	depends on PACKAGE_MATHCONTEXT

comment "The UDG algorithm requires the Pattern Matching driver"
	depends on !PATTERN_MATCHING_DRV

comment "The UDG algorithm requires the package Mathcontext"
	depends on !PACKAGE_MATHCONTEXT

config SENSOR_CORE_ALGO_DEMO
	bool "Algo Demo"

endmenu

endif

endmenu
```
